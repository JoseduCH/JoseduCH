//Librerias necesarias para el desarrollo de la de la medición del nivel del tanque del diesel
#include <WiFi.h>								
#include <WiFiMulti.h>
#include <HTTPClient.h>
#include <WiFiClientSecure.h>
#include "UbidotsEsp32Mqtt.h"
#include <Adafruit_GFX.h>
#include <Adafruit_SSD1306.h>
#include <Wire.h>
#include <cmath>

#define SCREEN_WIDTH 128
#define SCREEN_HEIGHT 64
#define OLED_RESET -1

Adafruit_SSD1306 display(SCREEN_WIDTH, SCREEN_HEIGHT, &Wire, OLED_RESET);

//Imagen de advertencia
const unsigned char epd_bitmap_advertencia [] PROGMEM = {
	0x00, 0x00, 0x00, 0x00, 0x00, 0x00, 0x00, 0x00, 0x00, 0x00, 0x00, 0x00, 0x00, 0x00, 0x00, 0x00, 
	0x00, 0x00, 0x00, 0x00, 0x00, 0x00, 0x00, 0x00, 0x00, 0x00, 0x00, 0x00, 0x00, 0x00, 0x00, 0x00, 
	0x00, 0x00, 0x00, 0x00, 0x00, 0x00, 0x00, 0x00, 0x00, 0x00, 0x00, 0x00, 0x00, 0x00, 0x00, 0x00, 
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	0x00, 0x00, 0x00, 0x00, 0x00, 0x00, 0x00, 0x00, 0x00, 0x00, 0x00, 0x00, 0x00, 0x00, 0x00, 0x00
};

float Volumen = 0.0;										//Volumen del tanque 

float R = 29.25;												//Radio del tanque
float Full = 25.0;											//Distancia mínima del sensor
float Empty = 78.5;											//Distancia máxima del sensor
float L = 87.7;													//Largo del tanque 
float capacity = Empty - Full;					//Capacidad que tiene el tanque

float Porcentaje;   										//Porcentaje del tanque
float h;																//Distancia medida del sensor al nivel de agua
float AT;																//Área del triángulo que se forma en el tanque en la base
float AS;																//Dos tercias partes del área de la base
float AB;    														//Área total de la base
float Vmax = 225.98;										//Volumen máximo a que puede estar el tanque

int triggerPin = 5;											//Definir el trigger pin que va a ir conectada al sensor
int echoPin = 18;												//Definir el echo pin

long duration;													//Variable para almacenar los datos del sensor
float cmDistance;												//Variable para transformar esos valores en cm
const int pinRojo = 25;									//Definir el pin rojo del LED RGB
const int pinVerde = 26;								//Definir el pin verde del LED RGB
const int pinAzul = 27;									//Definir el pin azul del LED RGB

int barX = 14;													//Barra en x para la medición del tanque en la pantalla
int barY = 20;													//Barra en y para la medición del tanque en la pantalla
int barWidth = 100;											//Ancho de la barra de la pantalla
int barHeight = 15;											//Altura de la barra de la pantalla

const char *UBIDOTS_TOKEN = "Token";	//Token del UBIDOTS

const char *DEVICE_LABEL = "Monitoreo";						//Nombre del dispositivo en UBIDOTS
const char *VARIABLE_LABEL1 = "porcentaje";				//Primera variable a mostrar en ubidots (Porcentaje)
const char *VARIABLE_LABEL2 = "volumen";					//Segunda variable a mostrar en ubidots (Volumen)

Ubidots ubidots(UBIDOTS_TOKEN);										//Iniciar en ubidots

unsigned long timer;															//Variable para almacenar tiempo 
const int PUBLISH_FREQUENCY = 5000;								//Frecuencia de publicación en milisegundos 

WiFiMulti wifiMulti;															//Objeto para manejar múltiples redes WIFI
const char* ssid1 = "RED";												//Nombre de la red WIFI
const char* password1 = "";												//Contraseña

String urlLoggIn = "URL"; //Aqui va el URL de la red con la que se va a trabajar

String urlSubmit = "URL"; //URL que envía los datos de autenticación
//Función que realiza una petición HTTP GET a una URL
int getHTTPPage(String url) {

  WiFiClientSecure client;												//Cliente seguro HTTP
  client.setInsecure();														//Desactiva la validación de certificados

  HTTPClient http;																//Objeto HTTP para manejar la petición 

  http.begin(client, url);												//Inicializa la conexión con la URL usando el cliente seguro

  int httpCode = http.GET();											//Realiza la petición GET y guarda el código de respuesta

  http.end();																			//Finaliza la conexión y libera recursos

  return httpCode;																//Retorna el código HTTP 
}

//Inicializa en WIFI		
void wifiInit(){

  Serial.print("Conectando WiFi");
	//Intenta conectarse hasta lograr conexión 
  while(wifiMulti.run() != WL_CONNECTED){
    Serial.print(".");
    delay(1000);
  }

  Serial.println("");
  Serial.println("WiFi conectado");

  delay(4000);														//Espera para asegurar estabilidad de conexión 

}

void setup() {
  ledcAttach(pinRojo, 5000, 8);						//Se define la frecuencia y la resolución del pin rojo
  ledcAttach(pinVerde, 5000, 8);					//Se define la frecuencia y la resolución del pin rojo
  ledcAttach(pinAzul, 5000, 8);						//Se define la frecuencia y la resolución del pin rojo

  pinMode(triggerPin, OUTPUT);						//Se define las entradas y salidas de la ESP32
  pinMode(echoPin, INPUT);

  Serial.begin(115200);										//Inicializa el monitor serial
		//Se checa si esta conectada la pantalla OLED
    if(!display.begin(SSD1306_SWITCHCAPVCC, 0x3C)){
    Serial.println(F("No se detectó la pantalla OLED"));
    for(;;);
  }
	wifiMulti.addAP(ssid1, password1);			//Se establece el modo de wifi en el que va a estar la esp32 con el nombre de la red y contraseña

	wifiInit();															//Se inicializa el modo de wifi

	ubidots.setup();												//Se inicializa el ubidos	
	ubidots.reconnect();										//Se reconecta en ubidots

	timer = millis();												//Se define el timer como el tiempo en el que inicia la ESP32
  display.clearDisplay();
  display.drawBitmap(0, 0, epd_bitmap_cicy, 128, 64, WHITE);	//Se muestra el logo del CICY por un segundo
  display.display();
  delay(1000);
}

void loop() {
  cmDistance = Distanciaprom(10);					//Se establece la distancia en cm a los valores del sensor

  Serial.print("Distancia [cm]: ");				//Se muestra el valor mostrado en el monitor serial
  Serial.println(cmDistance, 2);  				//Se muestran 2 decimales

  // Saturación de límites
  if(cmDistance < Full)
      cmDistance = Full;

  if(cmDistance > Empty)
      cmDistance = Empty;
  // Nivel real de líquido
  h = Empty - cmDistance;
	//Límites de altura 
	if (h < 0) h = 0;
	if (h > 2*R) h = 2*R;
	//Límites en los valores de radio y circumferencia
	float temp = 2*R*h - h*h;
	if(temp < 0) temp = 0;

	float arg = (R - h) / R;
	if(arg > 1) arg = 1;
	if(arg < -1) arg = -1;

	AT = (R - h) * sqrt(temp);		//Formula para encontrar AT
	AS = pow(R,2) * acos(arg);		//Formula para encontrar AS

	AB = AS - AT;									//Área total 
  
  Volumen = (AB*L) / 1000.0;		//Volumen en litros
	Porcentaje = (Volumen / Vmax) * 100.0;	//Porcentaje del tanque
	//Límite del porcentaje
	if(Porcentaje > 100.0){
		Porcentaje = 100.0;
	}
	//Mostrar en la pantalla el nivel del porcentaje del tanque
display.clearDisplay();
display.setTextColor(WHITE);
display.setTextSize(1);
display.setCursor(30,0);
display.println("PORCENTAJE");
//marco de la barra
display.drawRect(barX, barY, barWidth, barHeight, WHITE);

//convertir porcentaje a ancho
int nivel = map(Porcentaje, 0, 100, 0, barWidth);

//rellenar barra
display.fillRect(barX, barY, nivel, barHeight, WHITE);

display.setTextSize(2);
display.setTextColor(WHITE);
display.setCursor(40,45);
display.print(Porcentaje,1);
display.print("%");

display.display();

  Serial.print("Porcentaje [%]: ");		//Envio de datos en el monitor serial
  Serial.println(Porcentaje, 2);

  Serial.print("Volumen [L]: ");
  Serial.println(Volumen, 2);

  if(Porcentaje >=75 && Porcentaje <=100){
		//El LED enciende en verde
    ledcWrite(pinRojo,0);
    ledcWrite(pinVerde,255);
    ledcWrite(pinAzul, 0);
  } else if(Porcentaje >=25 && Porcentaje <75){
		//El LED enciende en amarillo
    ledcWrite(pinRojo,255);
    ledcWrite(pinVerde,255);
    ledcWrite(pinAzul, 0);
  } else{
		//Cambiar el texto a un nivel bajo del tanque
    display.clearDisplay();
    display.setTextColor(WHITE);
    display.setTextSize(1);
    display.setCursor(30,0);
    display.println("NIVEL BAJO");
    display.drawRect(barX, barY, barWidth, barHeight, WHITE);
    display.fillRect(barX, barY, nivel, barHeight, WHITE);
    display.setTextSize(2);
    display.setTextColor(WHITE);
    display.setCursor(40,45);
    display.print(Porcentaje,1);
    display.print("%");
    display.display();
		//Hacer que el LED parpadee
    for(int i = 0; i<=10; i++){
    ledcWrite(pinRojo,255);
    ledcWrite(pinVerde,0);
    ledcWrite(pinAzul, 0);
    delay(100);
    ledcWrite(pinRojo, 0);
    delay(100);
    } 
		//Mostrar un simbolo de advertencia
    display.clearDisplay();
    display.drawBitmap(0, 0, epd_bitmap_advertencia, 128, 64, WHITE);
    display.display();
    ledcWrite(pinRojo,255);
    delay(1000);
  }
	//Mandat los datos a ubidots
	if(!ubidots.connected()){
  ubidots.reconnect();
}

if((millis() - timer) > PUBLISH_FREQUENCY){

  ubidots.add(VARIABLE_LABEL1, Porcentaje);
  ubidots.add(VARIABLE_LABEL2, Volumen);

  ubidots.publish(DEVICE_LABEL);

  Serial.println("Datos enviados a Ubidots");

  timer = millis();
}

ubidots.loop();

  Serial.println("----------------------");
  delay(200);
}
//Sacar un valor promedio de los datos enviados del sensor a la ESP32
float Distanciaprom(int muestras){
  float suma = 0;
    for(int i =0; i<muestras;i++){
       digitalWrite(triggerPin, LOW);
      delayMicroseconds(2);
      digitalWrite(triggerPin, HIGH);
      delayMicroseconds(10);
      digitalWrite(triggerPin, LOW);
  duration = pulseIn(echoPin, HIGH, 30000);
  float lectura = duration * 0.0343 / 2.0;

  suma += lectura;
  delay(30);
    }
    return suma/muestras;
}
